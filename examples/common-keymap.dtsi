/* Include once in the shared keymap. Both directions use the same instance. */
#include <behaviors/button_scroll.dtsi>

/* Optional settings; match the button to your host-side scroll action. */
&button_scroll {
    button = <MB3>;
    timeout-ms = <150>;
    wheel-step = <1>;
};

/* In the chosen layer:
 * sensor-bindings = <&enc_scaler SCRL_UP SCRL_DOWN>;
 */
