## Kconfig
```kconfig
DT_COMPAT_ZMK_BEHAVIOR_BUTTON_SCROLL := zmk,behavior-button-scroll

config ZMK_BEHAVIOR_BUTTON_SCROLL
    bool
    depends on ZMK_POINTING
    default $(dt_compat_enabled,$(DT_COMPAT_ZMK_BEHAVIOR_BUTTON_SCROLL))
```

## dts/bindings/behaviors/zmk,behavior-button-scroll.yaml
```yaml
# SPDX-License-Identifier: MIT

description: Wheel pulses while holding a mouse button until an idle timeout
compatible: "zmk,behavior-button-scroll"
include: one_param.yaml

properties:
  button:
    type: int
    default: 8
    enum: [1, 2, 4, 8, 16]
    description: Mouse button to hold while scrolling (MB1 through MB5).
  timeout-ms:
    type: int
    default: 150
    description: Positive idle time after the last processed rotation before release.
  wheel-step:
    type: int
    default: 1
    description: Number of wheel units per invocation (1 through 127).
```
