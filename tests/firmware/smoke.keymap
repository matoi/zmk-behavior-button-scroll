/* Compile-only mock scanner fixture. */
#include <behaviors.dtsi>
#include <behaviors/button_scroll.dtsi>

&settings_reset_kscan {
    rows = <1>;
};

/ {
    keymap {
        compatible = "zmk,keymap";
        base {
            bindings = <&button_scroll SCRL_UP>;
            sensor-bindings = <&enc_scaler SCRL_UP SCRL_DOWN>;
        };
    };
};
